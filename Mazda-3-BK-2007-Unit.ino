#include <Wire.h>
#include <Adafruit_GFX.h>
#include <Adafruit_SSD1306.h>
#include "BluetoothSerial.h"
#include "ELMduino.h"
#include <PinButton.h>
#include <ezButton.h>
#include <ESP32Encoder.h>
#include <BleKeyboard.h>
#include <esp_now.h>
#include <WiFi.h>


// 'button', 32x32px
const unsigned char button[] PROGMEM = {
  0x00, 0x1f, 0xf0, 0x00, 0x00, 0x10, 0x08, 0x00, 0x00, 0x20, 0x08, 0x00, 0x00, 0x20, 0x04, 0x00,
  0x00, 0x20, 0x04, 0x00, 0x00, 0x40, 0x02, 0x00, 0x00, 0x40, 0x02, 0x00, 0x00, 0x40, 0x01, 0x00,
  0x00, 0x40, 0x05, 0x00, 0x00, 0x40, 0x04, 0x80, 0x00, 0x40, 0x04, 0x40, 0x00, 0x48, 0x06, 0x40,
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  0x3f, 0xff, 0xff, 0xfc, 0x20, 0x00, 0x00, 0x04, 0x20, 0x00, 0x00, 0x04, 0x3f, 0xff, 0xff, 0xfc
};
// 'Bluetooth', 32x32px
const unsigned char Bluetooth32[] PROGMEM = {
  0x00, 0x0f, 0xf0, 0x00, 0x00, 0x0f, 0xf0, 0x00, 0x00, 0xf0, 0x0f, 0x00, 0x00, 0xf3, 0x0f, 0x00,
  0x03, 0x03, 0x00, 0xc0, 0x03, 0x03, 0xc0, 0xc0, 0x03, 0x03, 0xc0, 0xc0, 0x03, 0x03, 0x30, 0xc0,
  0x0c, 0x03, 0x30, 0x30, 0x0c, 0x03, 0x0c, 0x30, 0x0c, 0x03, 0x0c, 0x30, 0x0c, 0x33, 0x30, 0x30,
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  0x00, 0xf3, 0x0f, 0x00, 0x00, 0xf0, 0x0f, 0x00, 0x00, 0x0f, 0xf0, 0x00, 0x00, 0x0f, 0xf0, 0x00
};
// 'center_fill', 8x8px
const unsigned char bitmap_center_fill[] PROGMEM = {
  0x00, 0x3c, 0x7e, 0x7e, 0x7e, 0x7e, 0x3c, 0x00
};
// 'center_outline', 8x8px
const unsigned char bitmap_center_outline[] PROGMEM = {
  0x00, 0x3c, 0x42, 0x42, 0x42, 0x42, 0x3c, 0x00
};
// 'gauge_bg', 72x64px
const unsigned char bitmap_gauge_bg[] PROGMEM = {
  0x00, 0x00, 0x00, 0x00, 0x00, 0x00, 0x00, 0x00, 0x00, 0x00, 0x00, 0x00, 0x04, 0x08, 0x20, 0x00,
  0x00, 0x00, 0x00, 0x00, 0x00, 0x04, 0x08, 0x20, 0x00, 0x00, 0x00, 0x00, 0x00, 0x01, 0x00, 0x00,
  0x00, 0x80, 0x00, 0x00, 0x00, 0x00, 0x01, 0x03, 0xff, 0xc0, 0x80, 0x00, 0x00, 0x00, 0x00, 0x20,
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  0x00, 0x00, 0x00, 0x00, 0x00, 0x08, 0x00, 0x00, 0x20, 0x00, 0x00, 0x00, 0x00, 0x00, 0x04, 0x00
};
// 'VoltMeter', 118x50px
const unsigned char batteryVoltMeter[] PROGMEM = {
  0x00, 0x00, 0x00, 0x00, 0x00, 0x00, 0x00, 0x00, 0x00, 0x00, 0x00, 0x00, 0x00, 0x00, 0x00, 0x00,
  0x00, 0x00, 0x00, 0x00, 0x00, 0x00, 0x00, 0x00, 0x00, 0x00, 0x00, 0x00, 0x00, 0x00, 0x00, 0x00,
  0x00, 0x00, 0x00, 0x00, 0x00, 0x00, 0x00, 0x00, 0x00, 0x00, 0x00, 0x00, 0x00, 0x00, 0x00, 0x00,
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  0x00, 0x00, 0x00, 0x00, 0x00, 0x0e, 0x00, 0x00, 0x00, 0x00, 0x00, 0x00, 0x00, 0x00
};
// 'scrollbar_background', 8x64px
const unsigned char bitmap_scrollbar_background[] PROGMEM = {
  0x00, 0x02, 0x00, 0x02, 0x00, 0x02, 0x00, 0x02, 0x00, 0x02, 0x00, 0x02, 0x00, 0x02, 0x00, 0x02,
  0x00, 0x02, 0x00, 0x02, 0x00, 0x02, 0x00, 0x02, 0x00, 0x02, 0x00, 0x02, 0x00, 0x02, 0x00, 0x02,
  0x00, 0x02, 0x00, 0x02, 0x00, 0x02, 0x00, 0x02, 0x00, 0x02, 0x00, 0x02, 0x00, 0x02, 0x00, 0x02,
  0x00, 0x02, 0x00, 0x02, 0x00, 0x02, 0x00, 0x02, 0x00, 0x02, 0x00, 0x02, 0x00, 0x02, 0x00, 0x00
};
// 'item_sel_outline', 128x21px
const unsigned char bitmap_item_sel_outline[] PROGMEM = {
  0x1f, 0xff, 0xff, 0xff, 0xff, 0xff, 0xff, 0xff, 0xff, 0xff, 0xff, 0xff, 0xff, 0xff, 0xff, 0xc0,
  0x20, 0x00, 0x00, 0x00, 0x00, 0x00, 0x00, 0x00, 0x00, 0x00, 0x00, 0x00, 0x00, 0x00, 0x00, 0x20,
  0x40, 0x00, 0x00, 0x00, 0x00, 0x00, 0x00, 0x00, 0x00, 0x00, 0x00, 0x00, 0x00, 0x00, 0x00, 0x30,
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  0x1f, 0xff, 0xff, 0xff, 0xff, 0xff, 0xff, 0xff, 0xff, 0xff, 0xff, 0xff, 0xff, 0xff, 0xff, 0xc0
};
// 'Gas can', 36x56px
const unsigned char gas_can[] PROGMEM = {
  0x00, 0x00, 0x00, 0xff, 0x00, 0x00, 0x00, 0x00, 0xff, 0x00, 0x00, 0x00, 0x00, 0x7e, 0x00, 0x00,
  0x00, 0x00, 0x7e, 0x00, 0x03, 0xff, 0xff, 0xff, 0xc0, 0x07, 0xff, 0xff, 0xff, 0xe0, 0x0c, 0x00,
  0x0c, 0x00, 0x30, 0x18, 0x00, 0x0c, 0x00, 0x30, 0x30, 0x00, 0x0c, 0x00, 0x30, 0x60, 0x00, 0x0c,
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  0xff, 0xff, 0xe0, 0x3f, 0xff, 0xff, 0xff, 0xc0
};
// Obrazky

#define BUTTON1_PIN 19    // ESP32 pin GIOP19, which connected to button to controll relay1
#define SCREEN_WIDTH 128  // OLED width,  in pixels
#define SCREEN_HEIGHT 64  // OLED height, in pixels
#define OLED_RESET -1     // Reset pin # (or -1 if sharing Arduino reset pin)
#define CLK 18            // CLK ENCODER TEST 18
#define DT 34             // DT ENCODER   TEST 36

#define pwmPin A0
int filteredValue = 0;    // Vyhladená hodnota zo senzora
int lastOutput = 0;       // Posledná výstupná hodnota pre LED
bool displayDim = false;  // Stav funkcie dim() displeja

const int lowerThreshold = 50;        // Dolná hranica pre zapnutie displeja
const int upperThreshold = 150;       // Horná hranica pre vypnutie displeja
const unsigned long interval = 1000;  // Časový interval na kontrolu (napr. 500 ms)

unsigned long Last_Check = 0;
unsigned long
  //Relay board
  int RelayPins[] = { 5, 32, 33, 25, 26, 27, 14, 13 };
bool RelayState[8];

ESP32Encoder encoder;
BluetoothSerial SerialBT;
#define ELM_PORT SerialBT

BleKeyboard bleKeyboard("Mazda 3 Control", "Radovan Findra", 100);

PinButton pinButton1(BUTTON1_PIN);
ezButton button1(BUTTON1_PIN);

Adafruit_SSD1306 oled(SCREEN_WIDTH, SCREEN_HEIGHT, &Wire, OLED_RESET);
uint8_t broadcastAddress[] = { 0xD8, 0xBF, 0xC0, 0x0D, 0x17, 0x5C };  // esp01 v aute 0xD8, 0xBF, 0xC0, 0x0D, 0x17, 0x5C // esp01 doma 0x8C, 0xAA, 0xB5, 0x0E, 0x8D, 0x59
uint8_t address[6] = { 0xba, 0xd6, 0x86, 0x74, 0xa0, 0x6e };          //enter the ELM327 MAC address after the 0x
ELM327 myELM327;
#include <FluxGarage_RoboEyes.h>
roboEyes roboEyes;

// variables will change:
long myTimeLast = 0;     // posledne ulozene millis
long myTime = 0;         // aktualne millis
bool connected = false;  // pripojednie ELM327
unsigned long myTimeLast_media = 0;
int curFace = 0;  // aktualna tvar

// car parameters
float fuelLevel = 0;
float fuelPressure = 0;
float voltage = 0;
float intakeAirTemp = 0;

long old_pos_face;

//Menu
long old_pos;
const int NUM_ITEMS = 8;         // number of items in the list and also the number of screenshots and screenshots with QR codes (other screens)
const int MAX_ITEM_LENGTH = 20;  // maximum characters for the item name

int item_selected = 0;  // which item in the menu is selected

int item_sel_previous;  // previous item - used in the menu screen to draw the item before the selected one
int item_sel_next;      // next item - used in the menu screen to draw next item after the selected one

String current_screen = "menu";  // 0 = menu, 1 = podmenu, 2 = relay_menu, 3 = interior_menu

//Menu_relay
long old_pos_relay;
const int NUM_ITEMS_relay = 10;        // number of items in the list and also the number of screenshots and screenshots with QR codes (other screens)
const int MAX_ITEM_LENGTH_relay = 20;  // maximum characters for the item name


int item_selected_relay = 0;  // which item in the menu is selected

int item_sel_previous_relay;  // previous item - used in the menu screen to draw the item before the selected one
int item_sel_next_relay;      // next item - used in the menu screen to draw next item after the selected one

String current_screen_relay = "menu";  // 0 = menu, 1 = podmenu

//Menu_interior

long old_pos_interior;
const int NUM_ITEMS_interior = 80;        // number of items in the list and also the number of screenshots and screenshots with QR codes (other screens)
const int MAX_ITEM_LENGTH_interior = 20;  // maximum characters for the item name

typedef struct struct_message {
  char head[4];
  int middle;
  char data[3][MAX_ITEM_LENGTH_interior];
  uint8_t LEDdata[5];
} struct_message;

struct_message out_message;
struct_message in_message;
esp_now_peer_info_t peerInfo;
char menu_items_interior[NUM_ITEMS_interior][MAX_ITEM_LENGTH_interior];
int item_selected_interior = 0;  // which item in the menu is selected

int item_sel_previous_interior;  // previous item - used in the menu screen to draw the item before the selected one
int item_sel_next_interior;      // next item - used in the menu screen to draw next item after the selected one
uint8_t LEDValues[5];

String current_screen_interior = "menu";  // 0 = menu, 1 = podmenu

// Dashboard
int needle_start_x;            // needle start point, x position
int needle_start_y;            // needle start point, y position
int needle_end_x;              // needle end point, x position
int needle_end_y;              // needle end point, y position
int needle_angle_deg = 45;     // angle of the needle in degrees, based on potentiometer value
int needle_center_x = 36;      // needle center position, x position
int needle_center_y = 36;      // needle center position, y position
int needle_radius_big = 30;    // lenght of needle
int needle_radius_small = 10;  // lenght of "tail" of the needle
int needle_offset_x;           // second line offset x
int needle_offset_y;           // second line offset y

TaskHandle_t PWM_Lookup;

void vynuluj_struct_message(struct_message *msg) {
  memset(msg, 0, sizeof(struct_message));
}  //vynuluj_struct_message

void OnDataSent(const uint8_t *mac_addr, esp_now_send_status_t status) {
}  //OnDataSent

void OnDataRecv(const esp_now_recv_info_t *recvInfo, const uint8_t *incomingData, int len) {
  memcpy(&in_message, incomingData, sizeof(in_message));
  // Serial.print("Bytes received: ");
  // Serial.println(len);
  // Serial.print("Head: ");
  // Serial.println(in_message.head);
  // Serial.print("Middle: ");
  // Serial.println(in_message.middle);
  // Serial.print("Data: ");
  //for (int i = 0; i < 3; i++) {
  // Serial.print(in_message.data[i]);
  // Serial.print(" , ");
  //}
  // Serial.println();
  // Serial.print("LED: ");
  //for (int i = 0; i < 5; i++) {
  //Serial.print(in_message.LEDdata[i]);
  //Serial.print(" , ");
  //}
  //Serial.println();
  if (strcmp(in_message.head, "ans") == 0) {
    int middle = item_selected_interior;
    int next;
    int previous;
    // set correct values for the previous and next items
    previous = middle - 1;
    if (previous < 0) {
      previous = NUM_ITEMS_interior - 1;  // previous item would be below first = make it the last
    }
    next = middle + 1;
    if (next >= MAX_ITEM_LENGTH_interior) {
      next = 0;  // next item would be after last = make it the first
    }

    for (int j = 0; j < MAX_ITEM_LENGTH_interior; j++) {
      menu_items_interior[previous][j] = in_message.data[0][j];
      menu_items_interior[middle][j] = in_message.data[1][j];
      menu_items_interior[next][j] = in_message.data[2][j];
    }
  }
  vynuluj_struct_message(&in_message);
}  //OnDataRecv

void req_Modes() {
  strcpy(out_message.head, "req");
  out_message.middle = item_selected_interior;
  strcpy(out_message.data[0], "mods");
  esp_now_send(broadcastAddress, (uint8_t *)&out_message, sizeof(out_message));
  vynuluj_struct_message(&out_message);
}  //req_Modes

void send_Data() {
  strcpy(out_message.head, "dat");  //dat
  for (int i = 0; i < 5; i++) {
    out_message.LEDdata[i] = LEDValues[i];

    //Serial.println(LEDValues[i]);
  }

  esp_now_send(broadcastAddress, (uint8_t *)&out_message, sizeof(out_message));
  vynuluj_struct_message(&out_message);
}  //send_Data

void setup() {
  const unsigned char madza3[] PROGMEM = {
    // 'mazda-3-vector-logo', 128x64px
    0x00, 0x00, 0x00, 0x00, 0x00, 0x00, 0x00, 0x00, 0x00, 0x00, 0x00, 0x00, 0x00, 0x00, 0x00, 0x00,
    0x00, 0x00, 0x00, 0x00, 0x00, 0x00, 0x00, 0x00, 0x00, 0x00, 0x00, 0x00, 0x00, 0x00, 0x00, 0x00,
    0x00, 0x00, 0x00, 0x00, 0x00, 0x00, 0x00, 0x00, 0x00, 0x00, 0x00, 0x00, 0x00, 0x00, 0x00, 0x00,
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    0x00, 0x00, 0x00, 0x00, 0x00, 0x00, 0x00, 0x00, 0x00, 0x00, 0x00, 0x00, 0x00, 0x00, 0x00, 0x00
  };
  const unsigned char madza_jap[] PROGMEM = {
    // 'il_570xN', 128x64px
    0x00, 0x00, 0x00, 0x00, 0x00, 0x00, 0x00, 0x00, 0x00, 0x00, 0x00, 0x00, 0x00, 0x00, 0x00, 0x00,
    0x00, 0x00, 0x00, 0x00, 0x00, 0x00, 0x00, 0x00, 0x00, 0x00, 0x00, 0x00, 0x00, 0x00, 0x00, 0x00,
    0x00, 0x00, 0x00, 0x00, 0x00, 0x00, 0x00, 0x00, 0x00, 0x00, 0x00, 0x00, 0x00, 0x00, 0x00, 0x00,
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    0x00, 0x00, 0x00, 0x00, 0x00, 0x00, 0x00, 0x00, 0x00, 0x00, 0x00, 0x00, 0x00, 0x00, 0x00, 0x00
  };
  Serial.begin(115200);  // initialize serial
  pinMode(pwmPin, INPUT);

  if (!oled.begin(SSD1306_SWITCHCAPVCC, 0x3C)) {
    while (1)
      ;
  }
  oled.setRotation(0);
  oled.setTextColor(WHITE);
  oled.clearDisplay();  // clear display
  oled.setCursor(0, 0);
  oled.drawBitmap(0, 0, madza_jap, 128, 64, WHITE);
  oled.display();

  for (int o = 0; o < 8; o++) {
    RelayState[o] = HIGH;
    pinMode(RelayPins[o], OUTPUT);
    digitalWrite(RelayPins[o], RelayState[o]);
  }

  encoder.attachHalfQuad(DT, CLK);
  encoder.setCount(0);
  ELM_PORT.begin("ArduHUD", true);
  {
    if (button1.getStateRaw()) {
      oled.setRotation(2);
      oled.setCursor(10, 55);
      oled.print("Connecting...");
      oled.display();
      if (ELM_PORT.connect(address)) {  //"OBDII" replaced by "address"
        myELM327.begin(ELM_PORT, true, 2000);
        connected = true;
      }
    } else {
      oled.setCursor(15, 45);
      oled.print("Connecting Skipped");
      oled.display();
    }

    oled.clearDisplay();
    oled.setRotation(0);
    oled.setCursor(0, 0);
    oled.drawBitmap(0, 0, madza3, 128, 64, WHITE);
    oled.display();
    //delay(500);
    oled.setRotation(2);

  }  //animaca
  ESP_now_Setup();
  bleKeyboard.begin();
  LEDValues[0] = 255;

  roboEyes.begin(SCREEN_WIDTH, SCREEN_HEIGHT, 60);  // screen-width, screen-height, max framerate


  roboEyes.setAutoblinker(ON, 3, 2);  // Start auto blinker animation cycle -> bool active, int interval, int variation -> turn on/off, set interval between each blink in full seconds, set range for random interval variation in full seconds
  roboEyes.setIdleMode(ON, 2, 2);     // Start idle animation cycle (eyes looking in random directions) -> turn on/off, set interval between each eye repositioning in full seconds, set range for random time interval variation in full seconds


  xTaskCreatePinnedToCore(
    PWM_Look,     /* Function to implement the task */
    "PWM_Lookup", /* Name of the task */
    10000,        /* Stack size in words */
    NULL,         /* Task input parameter */
    0,            /* Priority of the task */
    &PWM_Lookup,  /* Task handle. */
    0);           /* Core where the task should run */
}  //Setup

void ESP_now_Setup() {

  // Set device as a Wi-Fi Station
  WiFi.mode(WIFI_STA);

  // Init ESP-NOW
  if (esp_now_init() != ESP_OK) {
    return;
  }

  // Once ESPNow is successfully Init, we will register for Send CB to
  // get the status of Trasnmitted packet
  esp_now_register_send_cb(OnDataSent);

  // Register peer
  memcpy(peerInfo.peer_addr, broadcastAddress, 6);
  peerInfo.channel = 0;
  peerInfo.encrypt = false;

  // Add peer
  if (esp_now_add_peer(&peerInfo) != ESP_OK) {

    return;
  }
  // Register for a callback function that will be called when data is received
  esp_now_register_recv_cb(OnDataRecv);
}  //ESP_now_Setup

void PWM_Look(void *parameter) {
  for (;;) {
    if (millis() - Last_Check >= 50) {
      // Ak uplynul časový interval bez nového čítania, použiť poslednú platnú hodnotu

      //Serial.println(lastValidPWM);
      int rawPWM = pulseIn(pwmPin, HIGH, 42000);  // Nevyhladená hodnota PWM
      filteredValue = (rawPWM + 3 * filteredValue) / 4;

      // Normalizácia - premapovanie hodnôt z rozsahu 0-4200 na 0-255
      int normalizedValue = map(filteredValue, 4200, 0, 0, 255);

      // Obmedzenie rozdielov
      if (abs(normalizedValue - lastOutput) > 50) {
        if (normalizedValue > lastOutput) {
          normalizedValue = min(normalizedValue, lastOutput + 10);
        } else {
          normalizedValue = max(normalizedValue, lastOutput - 10);
        }
      }
      if (normalizedValue < 0) {
        normalizedValue = 0;
      }

      // Lineárna interpolácia - plynulý prechod medzi hodnotami
      int step = (normalizedValue > lastOutput) ? 1 : -1;
      for (int i = lastOutput; i != normalizedValue; i += step) {
        LEDValues[3] = normalizedValue;
        //Serial.println(LEDValues[3]);
        send_Data();
      }

      // Nastavenie výstupu pre LED na konečnú hodnotu
      LEDValues[3] = normalizedValue;
      //Serial.println(LEDValues[3]);
      send_Data();

      // Kontrola intenzity svetla pre zapnutie displeja
      if (normalizedValue < lowerThreshold) {
        oled.dim(true);
      } else if (normalizedValue > upperThreshold) {
        oled.dim(false);
      }
      lastOutput = normalizedValue;
      Last_Check = millis();
    }
  }
}

void loop() {

  // if (millis() - Last_Check >= 50) {
  //   // Ak uplynul časový interval bez nového čítania, použiť poslednú platnú hodnotu
  //   PWM_Look();
  //   //Serial.println(lastValidPWM);
  //   Last_Check = millis();
  // }
  // set correct values for the previous and next items
  item_sel_previous = item_selected - 1;
  if (item_sel_previous < 0) {
    item_sel_previous = NUM_ITEMS - 1;  // previous item would be below first = make it the last
  }
  item_sel_next = item_selected + 1;
  if (item_sel_next >= NUM_ITEMS) {
    item_sel_next = 0;  // next item would be after last = make it the first
  }

  // set correct values for the previous and next items_relay
  item_sel_previous_relay = item_selected_relay - 1;
  if (item_sel_previous_relay < 0) {
    item_sel_previous_relay = NUM_ITEMS_relay - 1;  // previous item would be below first = make it the last
  }
  item_sel_next_relay = item_selected_relay + 1;
  if (item_sel_next_relay >= NUM_ITEMS_relay) {
    item_sel_next_relay = 0;  // next item would be after last = make it the first
  }

  // set correct values for the previous and next items_interior
  item_sel_previous_interior = item_selected_interior - 1;
  if (item_sel_previous_interior < 0) {
    item_sel_previous_interior = NUM_ITEMS_interior - 1;  // previous item would be below first = make it the last
  }
  item_sel_next_interior = item_selected_interior + 1;
  if (item_sel_next_interior >= NUM_ITEMS_interior) {
    item_sel_next_interior = 0;  // next item would be after last = make it the first
  }

  pinButton1.update();

  if (pinButton1.isSingleClick()) {  // select button clicked, jump between screens

    if (current_screen == "menu") {
      if (item_selected == 5) {
        current_screen = "relay_menu";
        old_pos_relay = encoder.getCount() / 2;
        item_selected_relay = 0;
      } else if (item_selected == 6) {
        current_screen = "interior_menu";
        old_pos_interior = encoder.getCount() / 2;
        item_selected_interior = 0;
      } else {
        current_screen = "podmenu";  // menu items screen --> podmenu screen
      }
    } else if (current_screen == "podmenu") {
      current_screen = "menu";

    } else if (current_screen == "relay_menu") {

      if (item_selected_relay == 9) {
        current_screen = "menu";
        item_selected = 5;
        old_pos = encoder.getCount() / 2;
      } else if (item_selected_relay == 8) {
        for (int o = 0; o < sizeof(RelayPins); o++) {
          RelayState[o] = HIGH;
          digitalWrite(RelayPins[o], RelayState[o]);
        }
      } else {
        digitalWrite(RelayPins[item_selected_relay], !RelayState[item_selected_relay]);
        RelayState[item_selected_relay] = !RelayState[item_selected_relay];
      }
    } else if (current_screen == "interior_menu") {
      if (current_screen_interior == "menu") {
        current_screen_interior = "set";
      } else if (current_screen_interior == "set") {
        current_screen_interior = "menu";
        send_Data();
      } else if (current_screen_interior == "modes_set") {
        current_screen = "menu";
        current_screen_interior = "menu";
        item_selected = 6;
        item_selected_interior = 0;
      }
    }
  }
  if (pinButton1.isLongClick()) {
    if (current_screen == "interior_menu") {
      if (current_screen_interior == "menu") {
        current_screen_interior = "modes_set";
        item_selected_interior = 0;
        req_Modes();
      }
    }
  }

  if (current_screen == "relay_menu") {
    relayMenu();
  } else if (current_screen == "interior_menu") {
    interiorMenu();
  } else {
    ui();
  }

}  // LOOP

void signalSwitch() {
  if (pinButton1.isSingleClick()) {
    RelayState[1] = !RelayState[1];
    digitalWrite(RelayPins[1], RelayState[1]);
  }
}  // Signals Switch

void ui() {

  // 'icon_face', 16x16px
  const unsigned char bitmap_icon_face[] PROGMEM = {
    0x00, 0x00, 0x00, 0x00, 0x00, 0x00, 0xf8, 0x1f, 0xf8, 0x1f, 0x00, 0x00, 0x00, 0x00, 0x00, 0x00,
    0x00, 0x00, 0xc0, 0x03, 0xc0, 0x03, 0x3f, 0xfc, 0x3f, 0xfc, 0x00, 0x00, 0x00, 0x00, 0x00, 0x000
  };
  // 'icon_battery', 16x16px
  const unsigned char bitmap_icon_battery[] PROGMEM = {
    0x00, 0x00, 0x00, 0x00, 0x00, 0x00, 0x00, 0x00, 0x3f, 0xf8, 0x40, 0x04, 0x5b, 0x66, 0x5b, 0x66,
    0x5b, 0x66, 0x40, 0x04, 0x3f, 0xf8, 0x00, 0x00, 0x00, 0x00, 0x00, 0x00, 0x00, 0x00, 0x00, 0x00
  };
  // 'icon_dashboard', 16x16px
  const unsigned char bitmap_icon_dashboard[] PROGMEM = {
    0x07, 0xe0, 0x18, 0x18, 0x21, 0x24, 0x50, 0x02, 0x48, 0x0a, 0x84, 0x01, 0x83, 0x81, 0xa2, 0x45,
    0x82, 0x41, 0x81, 0x81, 0xa0, 0x05, 0x40, 0x02, 0x4b, 0xd2, 0x23, 0xc4, 0x18, 0x18, 0x07, 0xe0
  };
  // 'icon_bluetooth', 16x16px
  const unsigned char bitmap_icon_bluetooth[] PROGMEM = {
    0x03, 0xc0, 0x0d, 0x30, 0x11, 0x88, 0x11, 0xc8, 0x21, 0x64, 0x25, 0x64, 0x27, 0xc4, 0x23, 0x84,
    0x23, 0x84, 0x27, 0xc4, 0x25, 0x64, 0x21, 0x64, 0x11, 0xc8, 0x11, 0x88, 0x0d, 0x30, 0x03, 0xc0
  };
  // 'icon_fuel', 16x16px
  const unsigned char bitmap_icon_fuel[] PROGMEM = {
    0x3f, 0x90, 0x40, 0x4c, 0x40, 0x46, 0x40, 0x42, 0x40, 0x44, 0x40, 0x44, 0x40, 0x42, 0x7f, 0xe2,
    0x40, 0x72, 0x40, 0x52, 0x40, 0x53, 0x40, 0x51, 0x40, 0x51, 0x40, 0x41, 0x40, 0x4b, 0xff, 0xee
  };
  // 'icon_relay', 16x16px
  const unsigned char bitmap_icon_relay[] PROGMEM = {
    0x06, 0x60, 0x05, 0xa0, 0x06, 0x60, 0x05, 0xa0, 0x06, 0x60, 0x05, 0xa0, 0x04, 0x20, 0x18, 0x18,
    0x10, 0x08, 0x08, 0x10, 0x0c, 0x30, 0x03, 0xc0, 0x20, 0x04, 0x44, 0x22, 0x88, 0x11, 0x00, 0x00
  };
  // 'icon_parksensor', 16x16px
  const unsigned char bitmap_icon_parksensor[] PROGMEM = {
    0x00, 0x00, 0x00, 0x00, 0x00, 0x00, 0xfc, 0x00, 0x22, 0x00, 0x25, 0x00, 0xf9, 0x00, 0x00, 0x81,
    0x0c, 0x85, 0x12, 0x95, 0xd2, 0x95, 0x0c, 0x05, 0x00, 0x01, 0x00, 0x00, 0x00, 0x00, 0x00, 0x00
  };
  // 'icon_turbo', 16x16px
  const unsigned char bitmap_icon_turbo[] PROGMEM = {
    0x00, 0x0e, 0x07, 0xf1, 0x18, 0x01, 0x20, 0x01, 0x40, 0x01, 0x43, 0xf1, 0x84, 0x4e, 0x8a, 0xa0,
    0x89, 0x22, 0x8a, 0xa2, 0x84, 0x42, 0x43, 0x84, 0x40, 0x04, 0x20, 0x08, 0x18, 0x30, 0x07, 0xc0
  };
  // Array of all bitmaps for convenience.
  const unsigned char *bitmap_icons[8] = {
    bitmap_icon_face,
    bitmap_icon_battery,
    bitmap_icon_dashboard,
    bitmap_icon_bluetooth,
    bitmap_icon_fuel,
    bitmap_icon_relay,
    bitmap_icon_parksensor,
    bitmap_icon_turbo
  };

  char menu_items[NUM_ITEMS][MAX_ITEM_LENGTH] = { // array with item names
                                                  { "Face" },
                                                  { "Battery" },
                                                  { "Dashboard" },
                                                  { "Connection" },
                                                  { "Fuel State" },
                                                  { "ShowTime" },
                                                  { "Interior LED" },
                                                  { "Turbo Gauge" }
  };

  long pos = encoder.getCount() / 2;

  if (pos > old_pos) {
    if (current_screen == "menu") {
      item_selected = item_selected + 1;  // select next item
      if (item_selected >= NUM_ITEMS) {   // last item was selected, jump to first menu item
        item_selected = 0;
      }
    }
  }
  if (pos < old_pos) {
    if (current_screen == "menu") {
      item_selected = item_selected - 1;  // select next item
      if (item_selected < 0) {            // last item was selected, jump to first menu item
        item_selected = NUM_ITEMS - 1;
      }
    }
  }
  old_pos = pos;

  if (current_screen == "menu") {  // MENU SCREEN
    oled.clearDisplay();
    oled.drawBitmap(0, 22, bitmap_item_sel_outline, 128, 21, WHITE);
    oled.setCursor(25, 5);
    oled.print(menu_items[item_sel_previous]);
    oled.drawBitmap(4, 2, bitmap_icons[item_sel_previous], 16, 16, WHITE);  // draw selected item as icon + label in bold font
    oled.setCursor(25, 5 + 20 + 2);
    oled.print(menu_items[item_selected]);
    oled.drawBitmap(4, 24, bitmap_icons[item_selected], 16, 16, WHITE);  // draw next item as icon + label
    oled.setCursor(25, 5 + 20 + 20 + 2 + 2);
    oled.print(menu_items[item_sel_next]);
    oled.drawBitmap(4, 46, bitmap_icons[item_sel_next], 16, 16, WHITE);      // draw scrollbar background
    oled.drawBitmap(128 - 8, 0, bitmap_scrollbar_background, 8, 64, WHITE);  // draw scrollbar handle
    oled.drawRect(125, 64 / NUM_ITEMS * item_selected, 3, 64 / NUM_ITEMS, WHITE);
  } else if (current_screen == "podmenu") {  // SCREENSHOTS SCREEN
    setting(item_selected);
  }
  oled.display();
}  // UI

void relayMenu() {
  // '30%', 16x16px
  const unsigned char signals[] PROGMEM = {
    0x06, 0x60, 0x05, 0xa0, 0x06, 0x60, 0x05, 0xa0, 0x06, 0x60, 0x05, 0xa0, 0x04, 0x20, 0x18, 0x18,
    0x10, 0x08, 0x08, 0x10, 0x0c, 0x30, 0x03, 0xc0, 0x20, 0x04, 0x44, 0x22, 0x88, 0x11, 0x00, 0x00
  };
  // 'flash', 16x16px
  const unsigned char flash[] PROGMEM = {
    0x00, 0x00, 0x00, 0x00, 0x00, 0x06, 0x00, 0x1e, 0x00, 0x7c, 0x01, 0xf0, 0x07, 0xc0, 0x1f, 0x00,
    0x3f, 0xfc, 0x3f, 0xfc, 0x00, 0xf8, 0x03, 0xe0, 0x0f, 0x80, 0x3e, 0x00, 0x30, 0x00, 0x00, 0x00
  };
  // 'street', 16x16px
  const unsigned char street[] PROGMEM = {
    0x11, 0x88, 0x11, 0x88, 0x11, 0x84, 0x21, 0x84, 0x21, 0x84, 0x20, 0x04, 0x21, 0x84, 0x21, 0x82,
    0x41, 0x82, 0x41, 0x82, 0x41, 0x82, 0x41, 0x82, 0x40, 0x02, 0x83, 0xc1, 0x83, 0xc1, 0x83, 0xc1
  };

  char menu_items_relay[NUM_ITEMS_relay][MAX_ITEM_LENGTH_relay] = {
    // array with item names
    { "Signals" },
    { "Storbe" },
    { "Relay3" },
    { "Relay4" },
    { "Relay5" },
    { "Relay6" },
    { "Relay7" },
    { "Relay8" },
    { "StreetLegal" },
    { "Back" },
  };

  const unsigned char *bitmap_icons_light[10] = {
    signals,
    flash,
    street,
    street,
    street,
    street,
    street,
    street,
    street,
    street,
  };
  long pos_relay = encoder.getCount() / 2;

  if (pos_relay > old_pos_relay) {
    if (current_screen_relay == "menu") {
      item_selected_relay = item_selected_relay + 1;  // select next item
      if (item_selected_relay >= NUM_ITEMS_relay) {   // last item was selected, jump to first menu item
        item_selected_relay = 0;
      }
    }
  }
  if (pos_relay < old_pos_relay) {
    if (current_screen_relay == "menu") {
      item_selected_relay = item_selected_relay - 1;  // select next item
      if (item_selected_relay < 0) {                  // last item was selected, jump to first menu item
        item_selected_relay = NUM_ITEMS_relay - 1;
      }
    }
  }
  old_pos_relay = pos_relay;


  if (current_screen_relay == "menu") {  // MENU SCREEN_relay
    oled.clearDisplay();
    oled.drawBitmap(0, 22, bitmap_item_sel_outline, 128, 21, WHITE);
    oled.setCursor(25, 5);
    oled.print(menu_items_relay[item_sel_previous_relay]);
    oled.drawBitmap(4, 2, bitmap_icons_light[item_sel_previous_relay], 16, 16, WHITE);  // draw selected item as icon + label in bold font
    oled.setCursor(25, 5 + 20 + 2);
    oled.print(menu_items_relay[item_selected_relay]);
    oled.drawBitmap(4, 24, bitmap_icons_light[item_selected_relay], 16, 16, WHITE);  // draw next item as icon + label

    oled.setCursor(100, 5 + 20 + 2);
    if (item_selected_relay < 8) {
      if (RelayState[item_selected_relay] == HIGH) {
        oled.print("OFF");
      } else {
        oled.print("ON");
      }
    }
    oled.setCursor(25, 5 + 20 + 20 + 2 + 2);
    oled.print(menu_items_relay[item_sel_next_relay]);
    oled.drawBitmap(4, 46, bitmap_icons_light[item_sel_next_relay], 16, 16, WHITE);  // draw scrollbar background
    oled.drawBitmap(128 - 8, 0, bitmap_scrollbar_background, 8, 64, WHITE);          // draw scrollbar handle
    oled.drawRect(125, 64 / NUM_ITEMS_relay * item_selected_relay, 3, 64 / NUM_ITEMS_relay, WHITE);
  }

  oled.display();
}  // relayMenu

void interiorMenu() {

  long pos_interior = encoder.getCount() / 2;

  if (pos_interior > old_pos_interior) {
    if (current_screen_interior == "menu") {
      item_selected_interior = item_selected_interior + 1;  // select next item
      if (item_selected_interior >= 3) {                    // last item was selected, jump to first menu item
        item_selected_interior = 0;
      }
    } else if (current_screen_interior == "set") {
      LEDValues[item_selected_interior]++;
    } else if (current_screen_interior == "modes_set") {

      item_selected_interior = item_selected_interior + 1;  // select next item
      if (item_selected_interior >= NUM_ITEMS_interior) {   // last item was selected, jump to first menu item
        item_selected_interior = 0;
      }
      req_Modes();
    }
  }
  if (pos_interior < old_pos_interior) {
    if (current_screen_interior == "menu") {
      item_selected_interior = item_selected_interior - 1;  // select next item
      if (item_selected_interior < 0) {                     // last item was selected, jump to first menu item
        item_selected_interior = 3 - 1;
      }
    } else if (current_screen_interior == "set") {
      LEDValues[item_selected_interior]--;
    } else if (current_screen_interior == "modes_set") {

      item_selected_interior = item_selected_interior - 1;  // select next item
      if (item_selected_interior < 0) {                     // last item was selected, jump to first menu item
        item_selected_interior = NUM_ITEMS_interior - 1;
      }
      req_Modes();
    }
  }
  old_pos_interior = pos_interior;

  if (current_screen_interior == "menu" || current_screen_interior == "set") {
    oled.clearDisplay();
    oled.drawBitmap(0, item_selected_interior * 22, bitmap_item_sel_outline, 128, 21, WHITE);
    oled.setCursor(25, 5);
    oled.print("<   ");
    oled.print(LEDValues[0]);
    oled.println("   >");
    oled.setCursor(4, 5);
    oled.print("R:");  // draw selected item as icon + label in bold font
    oled.setCursor(25, 5 + 20 + 2);
    oled.print("<   ");
    oled.print(LEDValues[1]);
    oled.println("   >");
    oled.setCursor(4, 27);
    oled.print("G:");
    oled.setCursor(25, 5 + 20 + 20 + 2 + 2);
    oled.print("<   ");
    oled.print(LEDValues[2]);
    oled.println("   >");
    oled.setCursor(4, 49);
    oled.print("B:");

  } else if (current_screen_interior == "modes_set") {
    oled.clearDisplay();
    oled.drawBitmap(0, 22, bitmap_item_sel_outline, 128, 21, WHITE);
    oled.setCursor(25, 5);
    oled.print(menu_items_interior[item_sel_previous_interior]);
    oled.setCursor(25, 5 + 20 + 2);
    oled.print(menu_items_interior[item_selected_interior]);
    oled.setCursor(25, 5 + 20 + 20 + 2 + 2);
    oled.print(menu_items_interior[item_sel_next_interior]);
    oled.drawRect(125, 64 / NUM_ITEMS_interior * item_selected_interior, 3, 64 / NUM_ITEMS_interior, WHITE);
  }

  oled.display();
}  // interior_menu

void face() {
  // // 'Left', 128x64px
  // const unsigned char left[] PROGMEM = {
  //   0xff, 0xff, 0xff, 0xff, 0xff, 0xff, 0xc0, 0x00, 0x00, 0x03, 0xff, 0xff, 0xff, 0xff, 0xff, 0xff,
  //   0xff, 0xff, 0xff, 0xff, 0xff, 0xff, 0xc0, 0x00, 0x00, 0x03, 0xff, 0xff, 0xff, 0xff, 0xff, 0xff,
  //   0xff, 0xff, 0xff, 0xff, 0xff, 0xff, 0xc0, 0x00, 0x00, 0x03, 0xff, 0xff, 0xff, 0xff, 0xff, 0xff,
  //   0xff, 0xff, 0xff, 0xff, 0xff, 0xff, 0xc0, 0x00, 0x00, 0x03, 0xff, 0xff, 0xff, 0xff, 0xff, 0xff,
  //   0xff, 0xff, 0xff, 0xff, 0xff, 0xff, 0xc0, 0x00, 0x00, 0x03, 0xff, 0xff, 0xff, 0xff, 0xff, 0xff,
  //   0xff, 0xff, 0xff, 0xff, 0xff, 0xff, 0xc0, 0x00, 0x00, 0x03, 0xff, 0xff, 0xff, 0xff, 0xff, 0xff,
  //   0xff, 0xff, 0xff, 0xff, 0xff, 0xff, 0xc0, 0x00, 0x00, 0x03, 0xff, 0xff, 0xff, 0xff, 0xff, 0xff,
  //   0xff, 0xff, 0xff, 0xff, 0xff, 0xff, 0xc0, 0x00, 0x00, 0x03, 0xff, 0xff, 0xff, 0xff, 0xff, 0xff,
  //   0xff, 0xff, 0xff, 0xff, 0xff, 0xff, 0xc0, 0x00, 0x00, 0x03, 0xff, 0xff, 0xff, 0xff, 0xff, 0xff,
  //   0xff, 0xff, 0xff, 0xff, 0xff, 0xff, 0xc0, 0x00, 0x00, 0x03, 0xff, 0xff, 0xff, 0xff, 0xff, 0xff,
  //   0xff, 0xff, 0x80, 0x00, 0x00, 0x00, 0x00, 0x00, 0x00, 0x03, 0xff, 0xfe, 0x00, 0x00, 0x00, 0x00,
  //   0xff, 0xff, 0x80, 0x00, 0x00, 0x00, 0x00, 0x00, 0x00, 0x03, 0xff, 0xfe, 0x00, 0x00, 0x00, 0x00,
  //   0xff, 0xff, 0x80, 0x00, 0x00, 0x00, 0x00, 0x00, 0x00, 0x03, 0xff, 0xfe, 0x00, 0x00, 0x00, 0x00,
  //   0xff, 0xff, 0x80, 0x00, 0x00, 0x00, 0x00, 0x00, 0x00, 0x03, 0xff, 0xfe, 0x00, 0x00, 0x00, 0x00,
  //   0xff, 0xff, 0x80, 0x00, 0x00, 0x00, 0x00, 0x00, 0x00, 0x03, 0xff, 0xfe, 0x00, 0x00, 0x00, 0x00,
  //   0xff, 0xff, 0x80, 0x00, 0x00, 0x00, 0x00, 0x00, 0x00, 0x03, 0xff, 0xfe, 0x00, 0x00, 0x00, 0x00,
  //   0xff, 0xff, 0x80, 0x00, 0x00, 0x00, 0x00, 0x00, 0x00, 0x03, 0xff, 0xfe, 0x00, 0x00, 0x00, 0x00,
  //   0xff, 0xff, 0x80, 0x00, 0x00, 0x00, 0x00, 0x00, 0x00, 0x03, 0xff, 0xfe, 0x00, 0x00, 0x00, 0x00,
  //   0xff, 0xff, 0x80, 0x00, 0x00, 0x00, 0x00, 0x00, 0x00, 0x03, 0xff, 0xfe, 0x00, 0x00, 0x00, 0x00,
  //   0xff, 0xff, 0x80, 0x00, 0x00, 0x00, 0x00, 0x00, 0x00, 0x03, 0xff, 0xfe, 0x00, 0x00, 0x00, 0x00,
  //   0x00, 0x00, 0x00, 0x00, 0x00, 0x00, 0x00, 0x00, 0x00, 0x00, 0x00, 0x00, 0x00, 0x00, 0x00, 0x00,
  //   0x00, 0x00, 0x00, 0x00, 0x00, 0x00, 0x00, 0x00, 0x00, 0x00, 0x00, 0x00, 0x00, 0x00, 0x00, 0x00,
  //   0x00, 0x00, 0x00, 0x00, 0x00, 0x00, 0x00, 0x00, 0x00, 0x00, 0x00, 0x00, 0x00, 0x00, 0x00, 0x00,
  //   0x00, 0x00, 0x00, 0x00, 0x00, 0x00, 0x00, 0x00, 0x00, 0x00, 0x00, 0x00, 0x00, 0x00, 0x00, 0x00,
  //   0x00, 0x00, 0x00, 0x00, 0x00, 0x00, 0x00, 0x00, 0x00, 0x00, 0x00, 0x00, 0x00, 0x00, 0x00, 0x00,
  //   0x00, 0x00, 0x00, 0x00, 0x00, 0x00, 0x00, 0x00, 0x00, 0x00, 0x00, 0x00, 0x00, 0x00, 0x00, 0x00,
  //   0x00, 0x00, 0x00, 0x00, 0x00, 0x00, 0x00, 0x00, 0x00, 0x00, 0x00, 0x00, 0x00, 0x00, 0x00, 0x00,
  //   0x00, 0x00, 0x00, 0x00, 0x00, 0x00, 0x00, 0x00, 0x00, 0x00, 0x00, 0x00, 0x00, 0x00, 0x00, 0x00,
  //   0x00, 0x00, 0x00, 0x00, 0x00, 0x00, 0x00, 0x00, 0x00, 0x00, 0x00, 0x00, 0x00, 0x00, 0x00, 0x00,
  //   0x00, 0x00, 0x00, 0x00, 0x00, 0x00, 0x00, 0x00, 0x00, 0x00, 0x00, 0x00, 0x00, 0x00, 0x00, 0x00,
  //   0x00, 0x00, 0x00, 0x00, 0x00, 0x00, 0x00, 0x00, 0x00, 0x00, 0x00, 0x00, 0x00, 0x00, 0x00, 0x00,
  //   0x00, 0x00, 0x00, 0x00, 0x00, 0x00, 0x00, 0x00, 0x00, 0x00, 0x00, 0x00, 0x00, 0x00, 0x00, 0x00,
  //   0x00, 0x00, 0x00, 0x00, 0x00, 0x00, 0x00, 0x00, 0x00, 0x00, 0x00, 0x00, 0x00, 0x00, 0x00, 0x00,
  //   0x00, 0x00, 0x00, 0x00, 0x00, 0x00, 0x00, 0x00, 0x00, 0x00, 0x00, 0x00, 0x00, 0x00, 0x00, 0x00,
  //   0x00, 0x00, 0x00, 0x00, 0x00, 0x00, 0x00, 0x00, 0x00, 0x00, 0x00, 0x00, 0x00, 0x00, 0x00, 0x00,
  //   0x00, 0x00, 0x00, 0x00, 0x00, 0x00, 0x00, 0x00, 0x00, 0x00, 0x00, 0x00, 0x00, 0x00, 0x00, 0x00,
  //   0x00, 0x00, 0x00, 0x00, 0x00, 0x00, 0x00, 0x00, 0x00, 0x00, 0x00, 0x00, 0x00, 0x00, 0x00, 0x00,
  //   0x00, 0x00, 0x00, 0x00, 0x00, 0x00, 0x00, 0x00, 0x00, 0x00, 0x00, 0x00, 0x00, 0x00, 0x00, 0x00,
  //   0x00, 0x00, 0x00, 0x00, 0x00, 0x00, 0x00, 0x00, 0x00, 0x00, 0x00, 0x00, 0x00, 0x00, 0x00, 0x00,
  //   0x00, 0x00, 0x00, 0x00, 0x00, 0x00, 0x00, 0x00, 0x00, 0x00, 0x00, 0x00, 0x00, 0x00, 0x00, 0x00,
  //   0x00, 0x00, 0x00, 0x00, 0x00, 0x00, 0x00, 0x00, 0x00, 0x00, 0x00, 0x00, 0x00, 0x00, 0x00, 0x00,
  //   0x00, 0x00, 0x00, 0x00, 0x00, 0x00, 0x00, 0x00, 0x00, 0x00, 0x00, 0x00, 0x00, 0x00, 0x00, 0x00,
  //   0x00, 0x00, 0x00, 0x00, 0x00, 0x00, 0x00, 0x00, 0x00, 0x00, 0x00, 0x00, 0x00, 0x00, 0x00, 0x00,
  //   0x00, 0x00, 0x00, 0x00, 0x00, 0x00, 0x00, 0x00, 0x00, 0x00, 0x00, 0x00, 0x00, 0x00, 0x00, 0x00,
  //   0x00, 0x00, 0x00, 0x00, 0x00, 0x00, 0x00, 0x00, 0x00, 0x00, 0x00, 0x00, 0x00, 0x00, 0x00, 0x00,
  //   0x00, 0x00, 0x00, 0x00, 0x00, 0x00, 0x00, 0x00, 0x00, 0x00, 0x00, 0x00, 0x00, 0x00, 0x00, 0x00,
  //   0x00, 0x00, 0x00, 0x00, 0x00, 0x00, 0x00, 0x00, 0x00, 0x00, 0x00, 0x00, 0x00, 0x00, 0x00, 0x00,
  //   0x00, 0x00, 0x00, 0x00, 0x00, 0x00, 0x00, 0x00, 0x00, 0x00, 0x00, 0x00, 0x00, 0x00, 0x00, 0x00,
  //   0x00, 0x00, 0x00, 0x00, 0x00, 0x00, 0x00, 0x00, 0x00, 0x00, 0x00, 0x00, 0x00, 0x00, 0x00, 0x00,
  //   0x00, 0x00, 0x00, 0x00, 0x00, 0x00, 0x00, 0x00, 0x00, 0x00, 0x00, 0x00, 0x00, 0x00, 0x00, 0x00,
  //   0x00, 0x00, 0x00, 0x00, 0x00, 0x00, 0x00, 0x00, 0x00, 0x00, 0x00, 0x00, 0x00, 0x00, 0x00, 0x00,
  //   0x00, 0x00, 0x00, 0x00, 0x00, 0x00, 0x00, 0x00, 0x00, 0x00, 0x00, 0x00, 0x00, 0x00, 0x00, 0x00,
  //   0x00, 0x00, 0x00, 0x00, 0x00, 0x00, 0x00, 0x00, 0x00, 0x00, 0x00, 0x00, 0x00, 0x00, 0x00, 0x00,
  //   0x00, 0x00, 0x00, 0x00, 0x00, 0x00, 0x00, 0x00, 0x00, 0x00, 0x00, 0x00, 0x00, 0x00, 0x00, 0x00,
  //   0x00, 0x00, 0x00, 0x00, 0x00, 0x00, 0x00, 0xff, 0xff, 0xff, 0xfc, 0x00, 0x00, 0x00, 0x00, 0x00,
  //   0x00, 0x00, 0x00, 0x00, 0x00, 0x00, 0x00, 0xff, 0xff, 0xff, 0xfc, 0x00, 0x00, 0x00, 0x00, 0x00,
  //   0x00, 0x00, 0x00, 0x00, 0x00, 0x00, 0x00, 0xff, 0xff, 0xff, 0xfc, 0x00, 0x00, 0x00, 0x00, 0x00,
  //   0x00, 0x00, 0x00, 0x00, 0x00, 0x00, 0x00, 0xff, 0xff, 0xff, 0xfc, 0x00, 0x00, 0x00, 0x00, 0x00,
  //   0x00, 0x00, 0x00, 0x00, 0x00, 0x00, 0x00, 0xff, 0xff, 0xff, 0xfc, 0x00, 0x00, 0x00, 0x00, 0x00,
  //   0x00, 0x00, 0x00, 0x00, 0x00, 0x00, 0x00, 0xff, 0xff, 0xff, 0xfc, 0x00, 0x00, 0x00, 0x00, 0x00,
  //   0x00, 0x00, 0x00, 0x00, 0x00, 0x00, 0x00, 0xff, 0xff, 0xff, 0xfc, 0x00, 0x00, 0x00, 0x00, 0x00,
  //   0x00, 0x00, 0x00, 0x00, 0x00, 0x00, 0x00, 0xff, 0xff, 0xff, 0xfc, 0x00, 0x00, 0x00, 0x00, 0x00,
  //   0x00, 0x00, 0x00, 0x00, 0x00, 0x00, 0x00, 0xff, 0xff, 0xff, 0xfc, 0x00, 0x00, 0x00, 0x00, 0x00,
  //   0x00, 0x00, 0x00, 0x00, 0x00, 0x00, 0x00, 0xff, 0xff, 0xff, 0xfc, 0x00, 0x00, 0x00, 0x00, 0x00
  // };
  // // 'Midle', 128x64px
  // const unsigned char midle[] PROGMEM = {
  //   0xff, 0xff, 0xff, 0xff, 0xff, 0xff, 0xc0, 0x00, 0x00, 0x03, 0xff, 0xff, 0xff, 0xff, 0xff, 0xff,
  //   0xff, 0xff, 0xff, 0xff, 0xff, 0xff, 0xc0, 0x00, 0x00, 0x03, 0xff, 0xff, 0xff, 0xff, 0xff, 0xff,
  //   0xff, 0xff, 0xff, 0xff, 0xff, 0xff, 0xc0, 0x00, 0x00, 0x03, 0xff, 0xff, 0xff, 0xff, 0xff, 0xff,
  //   0xff, 0xff, 0xff, 0xff, 0xff, 0xff, 0xc0, 0x00, 0x00, 0x03, 0xff, 0xff, 0xff, 0xff, 0xff, 0xff,
  //   0xff, 0xff, 0xff, 0xff, 0xff, 0xff, 0xc0, 0x00, 0x00, 0x03, 0xff, 0xff, 0xff, 0xff, 0xff, 0xff,
  //   0xff, 0xff, 0xff, 0xff, 0xff, 0xff, 0xc0, 0x00, 0x00, 0x03, 0xff, 0xff, 0xff, 0xff, 0xff, 0xff,
  //   0xff, 0xff, 0xff, 0xff, 0xff, 0xff, 0xc0, 0x00, 0x00, 0x03, 0xff, 0xff, 0xff, 0xff, 0xff, 0xff,
  //   0xff, 0xff, 0xff, 0xff, 0xff, 0xff, 0xc0, 0x00, 0x00, 0x03, 0xff, 0xff, 0xff, 0xff, 0xff, 0xff,
  //   0xff, 0xff, 0xff, 0xff, 0xff, 0xff, 0xc0, 0x00, 0x00, 0x03, 0xff, 0xff, 0xff, 0xff, 0xff, 0xff,
  //   0xff, 0xff, 0xff, 0xff, 0xff, 0xff, 0xc0, 0x00, 0x00, 0x03, 0xff, 0xff, 0xff, 0xff, 0xff, 0xff,
  //   0x00, 0x07, 0xff, 0xff, 0x80, 0x00, 0x00, 0x00, 0x00, 0x00, 0x00, 0x0f, 0xff, 0xfe, 0x00, 0x00,
  //   0x00, 0x07, 0xff, 0xff, 0x80, 0x00, 0x00, 0x00, 0x00, 0x00, 0x00, 0x0f, 0xff, 0xfe, 0x00, 0x00,
  //   0x00, 0x07, 0xff, 0xff, 0x80, 0x00, 0x00, 0x00, 0x00, 0x00, 0x00, 0x0f, 0xff, 0xfe, 0x00, 0x00,
  //   0x00, 0x07, 0xff, 0xff, 0x80, 0x00, 0x00, 0x00, 0x00, 0x00, 0x00, 0x0f, 0xff, 0xfe, 0x00, 0x00,
  //   0x00, 0x07, 0xff, 0xff, 0x80, 0x00, 0x00, 0x00, 0x00, 0x00, 0x00, 0x0f, 0xff, 0xfe, 0x00, 0x00,
  //   0x00, 0x07, 0xff, 0xff, 0x80, 0x00, 0x00, 0x00, 0x00, 0x00, 0x00, 0x0f, 0xff, 0xfe, 0x00, 0x00,
  //   0x00, 0x07, 0xff, 0xff, 0x80, 0x00, 0x00, 0x00, 0x00, 0x00, 0x00, 0x0f, 0xff, 0xfe, 0x00, 0x00,
  //   0x00, 0x07, 0xff, 0xff, 0x80, 0x00, 0x00, 0x00, 0x00, 0x00, 0x00, 0x0f, 0xff, 0xfe, 0x00, 0x00,
  //   0x00, 0x07, 0xff, 0xff, 0x80, 0x00, 0x00, 0x00, 0x00, 0x00, 0x00, 0x0f, 0xff, 0xfe, 0x00, 0x00,
  //   0x00, 0x07, 0xff, 0xff, 0x80, 0x00, 0x00, 0x00, 0x00, 0x00, 0x00, 0x0f, 0xff, 0xfe, 0x00, 0x00,
  //   0x00, 0x00, 0x00, 0x00, 0x00, 0x00, 0x00, 0x00, 0x00, 0x00, 0x00, 0x00, 0x00, 0x00, 0x00, 0x00,
  //   0x00, 0x00, 0x00, 0x00, 0x00, 0x00, 0x00, 0x00, 0x00, 0x00, 0x00, 0x00, 0x00, 0x00, 0x00, 0x00,
  //   0x00, 0x00, 0x00, 0x00, 0x00, 0x00, 0x00, 0x00, 0x00, 0x00, 0x00, 0x00, 0x00, 0x00, 0x00, 0x00,
  //   0x00, 0x00, 0x00, 0x00, 0x00, 0x00, 0x00, 0x00, 0x00, 0x00, 0x00, 0x00, 0x00, 0x00, 0x00, 0x00,
  //   0x00, 0x00, 0x00, 0x00, 0x00, 0x00, 0x00, 0x00, 0x00, 0x00, 0x00, 0x00, 0x00, 0x00, 0x00, 0x00,
  //   0x00, 0x00, 0x00, 0x00, 0x00, 0x00, 0x00, 0x00, 0x00, 0x00, 0x00, 0x00, 0x00, 0x00, 0x00, 0x00,
  //   0x00, 0x00, 0x00, 0x00, 0x00, 0x00, 0x00, 0x00, 0x00, 0x00, 0x00, 0x00, 0x00, 0x00, 0x00, 0x00,
  //   0x00, 0x00, 0x00, 0x00, 0x00, 0x00, 0x00, 0x00, 0x00, 0x00, 0x00, 0x00, 0x00, 0x00, 0x00, 0x00,
  //   0x00, 0x00, 0x00, 0x00, 0x00, 0x00, 0x00, 0x00, 0x00, 0x00, 0x00, 0x00, 0x00, 0x00, 0x00, 0x00,
  //   0x00, 0x00, 0x00, 0x00, 0x00, 0x00, 0x00, 0x00, 0x00, 0x00, 0x00, 0x00, 0x00, 0x00, 0x00, 0x00,
  //   0x00, 0x00, 0x00, 0x00, 0x00, 0x00, 0x00, 0x00, 0x00, 0x00, 0x00, 0x00, 0x00, 0x00, 0x00, 0x00,
  //   0x00, 0x00, 0x00, 0x00, 0x00, 0x00, 0x00, 0x00, 0x00, 0x00, 0x00, 0x00, 0x00, 0x00, 0x00, 0x00,
  //   0x00, 0x00, 0x00, 0x00, 0x00, 0x00, 0x00, 0x00, 0x00, 0x00, 0x00, 0x00, 0x00, 0x00, 0x00, 0x00,
  //   0x00, 0x00, 0x00, 0x00, 0x00, 0x00, 0x00, 0x00, 0x00, 0x00, 0x00, 0x00, 0x00, 0x00, 0x00, 0x00,
  //   0x00, 0x00, 0x00, 0x00, 0x00, 0x00, 0x00, 0x00, 0x00, 0x00, 0x00, 0x00, 0x00, 0x00, 0x00, 0x00,
  //   0x00, 0x00, 0x00, 0x00, 0x00, 0x00, 0x00, 0x00, 0x00, 0x00, 0x00, 0x00, 0x00, 0x00, 0x00, 0x00,
  //   0x00, 0x00, 0x00, 0x00, 0x00, 0x00, 0x00, 0x00, 0x00, 0x00, 0x00, 0x00, 0x00, 0x00, 0x00, 0x00,
  //   0x00, 0x00, 0x00, 0x00, 0x00, 0x00, 0x00, 0x00, 0x00, 0x00, 0x00, 0x00, 0x00, 0x00, 0x00, 0x00,
  //   0x00, 0x00, 0x00, 0x00, 0x00, 0x00, 0x00, 0x00, 0x00, 0x00, 0x00, 0x00, 0x00, 0x00, 0x00, 0x00,
  //   0x00, 0x00, 0x00, 0x00, 0x00, 0x00, 0x00, 0x00, 0x00, 0x00, 0x00, 0x00, 0x00, 0x00, 0x00, 0x00,
  //   0x00, 0x00, 0x00, 0x00, 0x00, 0x00, 0x00, 0x00, 0x00, 0x00, 0x00, 0x00, 0x00, 0x00, 0x00, 0x00,
  //   0x00, 0x00, 0x00, 0x00, 0x00, 0x00, 0x00, 0x00, 0x00, 0x00, 0x00, 0x00, 0x00, 0x00, 0x00, 0x00,
  //   0x00, 0x00, 0x00, 0x00, 0x00, 0x00, 0x00, 0x00, 0x00, 0x00, 0x00, 0x00, 0x00, 0x00, 0x00, 0x00,
  //   0x00, 0x00, 0x00, 0x00, 0x00, 0x00, 0x00, 0x00, 0x00, 0x00, 0x00, 0x00, 0x00, 0x00, 0x00, 0x00,
  //   0x00, 0x00, 0x00, 0x00, 0x00, 0x00, 0x00, 0x00, 0x00, 0x00, 0x00, 0x00, 0x00, 0x00, 0x00, 0x00,
  //   0x00, 0x00, 0x00, 0x00, 0x00, 0x00, 0x00, 0x00, 0x00, 0x00, 0x00, 0x00, 0x00, 0x00, 0x00, 0x00,
  //   0x00, 0x00, 0x00, 0x00, 0x00, 0x00, 0x00, 0x00, 0x00, 0x00, 0x00, 0x00, 0x00, 0x00, 0x00, 0x00,
  //   0x00, 0x00, 0x00, 0x00, 0x00, 0x00, 0x00, 0x00, 0x00, 0x00, 0x00, 0x00, 0x00, 0x00, 0x00, 0x00,
  //   0x00, 0x00, 0x00, 0x00, 0x00, 0x00, 0x00, 0x00, 0x00, 0x00, 0x00, 0x00, 0x00, 0x00, 0x00, 0x00,
  //   0x00, 0x00, 0x00, 0x00, 0x00, 0x00, 0x00, 0x00, 0x00, 0x00, 0x00, 0x00, 0x00, 0x00, 0x00, 0x00,
  //   0x00, 0x00, 0x00, 0x00, 0x00, 0x00, 0x00, 0x00, 0x00, 0x00, 0x00, 0x00, 0x00, 0x00, 0x00, 0x00,
  //   0x00, 0x00, 0x00, 0x00, 0x00, 0x00, 0x00, 0x00, 0x00, 0x00, 0x00, 0x00, 0x00, 0x00, 0x00, 0x00,
  //   0x00, 0x00, 0x00, 0x00, 0x00, 0x00, 0x00, 0x00, 0x00, 0x00, 0x00, 0x00, 0x00, 0x00, 0x00, 0x00,
  //   0x00, 0x00, 0x00, 0x00, 0x00, 0x00, 0x00, 0x00, 0x00, 0x00, 0x00, 0x00, 0x00, 0x00, 0x00, 0x00,
  //   0x00, 0x00, 0x00, 0x00, 0x00, 0x00, 0x1f, 0xff, 0xff, 0xff, 0x80, 0x00, 0x00, 0x00, 0x00, 0x00,
  //   0x00, 0x00, 0x00, 0x00, 0x00, 0x00, 0x1f, 0xff, 0xff, 0xff, 0x80, 0x00, 0x00, 0x00, 0x00, 0x00,
  //   0x00, 0x00, 0x00, 0x00, 0x00, 0x00, 0x1f, 0xff, 0xff, 0xff, 0x80, 0x00, 0x00, 0x00, 0x00, 0x00,
  //   0x00, 0x00, 0x00, 0x00, 0x00, 0x00, 0x1f, 0xff, 0xff, 0xff, 0x80, 0x00, 0x00, 0x00, 0x00, 0x00,
  //   0x00, 0x00, 0x00, 0x00, 0x00, 0x00, 0x1f, 0xff, 0xff, 0xff, 0x80, 0x00, 0x00, 0x00, 0x00, 0x00,
  //   0x00, 0x00, 0x00, 0x00, 0x00, 0x00, 0x1f, 0xff, 0xff, 0xff, 0x80, 0x00, 0x00, 0x00, 0x00, 0x00,
  //   0x00, 0x00, 0x00, 0x00, 0x00, 0x00, 0x1f, 0xff, 0xff, 0xff, 0x80, 0x00, 0x00, 0x00, 0x00, 0x00,
  //   0x00, 0x00, 0x00, 0x00, 0x00, 0x00, 0x1f, 0xff, 0xff, 0xff, 0x80, 0x00, 0x00, 0x00, 0x00, 0x00,
  //   0x00, 0x00, 0x00, 0x00, 0x00, 0x00, 0x1f, 0xff, 0xff, 0xff, 0x80, 0x00, 0x00, 0x00, 0x00, 0x00,
  //   0x00, 0x00, 0x00, 0x00, 0x00, 0x00, 0x1f, 0xff, 0xff, 0xff, 0x80, 0x00, 0x00, 0x00, 0x00, 0x00
  // };
  // // 'Rigth', 128x64px
  // const unsigned char rigth[] PROGMEM = {
  //   0xff, 0xff, 0xff, 0xff, 0xff, 0xff, 0xc0, 0x00, 0x00, 0x03, 0xff, 0xff, 0xff, 0xff, 0xff, 0xff,
  //   0xff, 0xff, 0xff, 0xff, 0xff, 0xff, 0xc0, 0x00, 0x00, 0x03, 0xff, 0xff, 0xff, 0xff, 0xff, 0xff,
  //   0xff, 0xff, 0xff, 0xff, 0xff, 0xff, 0xc0, 0x00, 0x00, 0x03, 0xff, 0xff, 0xff, 0xff, 0xff, 0xff,
  //   0xff, 0xff, 0xff, 0xff, 0xff, 0xff, 0xc0, 0x00, 0x00, 0x03, 0xff, 0xff, 0xff, 0xff, 0xff, 0xff,
  //   0xff, 0xff, 0xff, 0xff, 0xff, 0xff, 0xc0, 0x00, 0x00, 0x03, 0xff, 0xff, 0xff, 0xff, 0xff, 0xff,
  //   0xff, 0xff, 0xff, 0xff, 0xff, 0xff, 0xc0, 0x00, 0x00, 0x03, 0xff, 0xff, 0xff, 0xff, 0xff, 0xff,
  //   0xff, 0xff, 0xff, 0xff, 0xff, 0xff, 0xc0, 0x00, 0x00, 0x03, 0xff, 0xff, 0xff, 0xff, 0xff, 0xff,
  //   0xff, 0xff, 0xff, 0xff, 0xff, 0xff, 0xc0, 0x00, 0x00, 0x03, 0xff, 0xff, 0xff, 0xff, 0xff, 0xff,
  //   0xff, 0xff, 0xff, 0xff, 0xff, 0xff, 0xc0, 0x00, 0x00, 0x03, 0xff, 0xff, 0xff, 0xff, 0xff, 0xff,
  //   0xff, 0xff, 0xff, 0xff, 0xff, 0xff, 0xc0, 0x00, 0x00, 0x03, 0xff, 0xff, 0xff, 0xff, 0xff, 0xff,
  //   0x00, 0x00, 0x00, 0x00, 0x7f, 0xff, 0xc0, 0x00, 0x00, 0x00, 0x00, 0x00, 0x00, 0x01, 0xff, 0xff,
  //   0x00, 0x00, 0x00, 0x00, 0x7f, 0xff, 0xc0, 0x00, 0x00, 0x00, 0x00, 0x00, 0x00, 0x01, 0xff, 0xff,
  //   0x00, 0x00, 0x00, 0x00, 0x7f, 0xff, 0xc0, 0x00, 0x00, 0x00, 0x00, 0x00, 0x00, 0x01, 0xff, 0xff,
  //   0x00, 0x00, 0x00, 0x00, 0x7f, 0xff, 0xc0, 0x00, 0x00, 0x00, 0x00, 0x00, 0x00, 0x01, 0xff, 0xff,
  //   0x00, 0x00, 0x00, 0x00, 0x7f, 0xff, 0xc0, 0x00, 0x00, 0x00, 0x00, 0x00, 0x00, 0x01, 0xff, 0xff,
  //   0x00, 0x00, 0x00, 0x00, 0x7f, 0xff, 0xc0, 0x00, 0x00, 0x00, 0x00, 0x00, 0x00, 0x01, 0xff, 0xff,
  //   0x00, 0x00, 0x00, 0x00, 0x7f, 0xff, 0xc0, 0x00, 0x00, 0x00, 0x00, 0x00, 0x00, 0x01, 0xff, 0xff,
  //   0x00, 0x00, 0x00, 0x00, 0x7f, 0xff, 0xc0, 0x00, 0x00, 0x00, 0x00, 0x00, 0x00, 0x01, 0xff, 0xff,
  //   0x00, 0x00, 0x00, 0x00, 0x7f, 0xff, 0xc0, 0x00, 0x00, 0x00, 0x00, 0x00, 0x00, 0x01, 0xff, 0xff,
  //   0x00, 0x00, 0x00, 0x00, 0x7f, 0xff, 0xc0, 0x00, 0x00, 0x00, 0x00, 0x00, 0x00, 0x01, 0xff, 0xff,
  //   0x00, 0x00, 0x00, 0x00, 0x00, 0x00, 0x00, 0x00, 0x00, 0x00, 0x00, 0x00, 0x00, 0x00, 0x00, 0x00,
  //   0x00, 0x00, 0x00, 0x00, 0x00, 0x00, 0x00, 0x00, 0x00, 0x00, 0x00, 0x00, 0x00, 0x00, 0x00, 0x00,
  //   0x00, 0x00, 0x00, 0x00, 0x00, 0x00, 0x00, 0x00, 0x00, 0x00, 0x00, 0x00, 0x00, 0x00, 0x00, 0x00,
  //   0x00, 0x00, 0x00, 0x00, 0x00, 0x00, 0x00, 0x00, 0x00, 0x00, 0x00, 0x00, 0x00, 0x00, 0x00, 0x00,
  //   0x00, 0x00, 0x00, 0x00, 0x00, 0x00, 0x00, 0x00, 0x00, 0x00, 0x00, 0x00, 0x00, 0x00, 0x00, 0x00,
  //   0x00, 0x00, 0x00, 0x00, 0x00, 0x00, 0x00, 0x00, 0x00, 0x00, 0x00, 0x00, 0x00, 0x00, 0x00, 0x00,
  //   0x00, 0x00, 0x00, 0x00, 0x00, 0x00, 0x00, 0x00, 0x00, 0x00, 0x00, 0x00, 0x00, 0x00, 0x00, 0x00,
  //   0x00, 0x00, 0x00, 0x00, 0x00, 0x00, 0x00, 0x00, 0x00, 0x00, 0x00, 0x00, 0x00, 0x00, 0x00, 0x00,
  //   0x00, 0x00, 0x00, 0x00, 0x00, 0x00, 0x00, 0x00, 0x00, 0x00, 0x00, 0x00, 0x00, 0x00, 0x00, 0x00,
  //   0x00, 0x00, 0x00, 0x00, 0x00, 0x00, 0x00, 0x00, 0x00, 0x00, 0x00, 0x00, 0x00, 0x00, 0x00, 0x00,
  //   0x00, 0x00, 0x00, 0x00, 0x00, 0x00, 0x00, 0x00, 0x00, 0x00, 0x00, 0x00, 0x00, 0x00, 0x00, 0x00,
  //   0x00, 0x00, 0x00, 0x00, 0x00, 0x00, 0x00, 0x00, 0x00, 0x00, 0x00, 0x00, 0x00, 0x00, 0x00, 0x00,
  //   0x00, 0x00, 0x00, 0x00, 0x00, 0x00, 0x00, 0x00, 0x00, 0x00, 0x00, 0x00, 0x00, 0x00, 0x00, 0x00,
  //   0x00, 0x00, 0x00, 0x00, 0x00, 0x00, 0x00, 0x00, 0x00, 0x00, 0x00, 0x00, 0x00, 0x00, 0x00, 0x00,
  //   0x00, 0x00, 0x00, 0x00, 0x00, 0x00, 0x00, 0x00, 0x00, 0x00, 0x00, 0x00, 0x00, 0x00, 0x00, 0x00,
  //   0x00, 0x00, 0x00, 0x00, 0x00, 0x00, 0x00, 0x00, 0x00, 0x00, 0x00, 0x00, 0x00, 0x00, 0x00, 0x00,
  //   0x00, 0x00, 0x00, 0x00, 0x00, 0x00, 0x00, 0x00, 0x00, 0x00, 0x00, 0x00, 0x00, 0x00, 0x00, 0x00,
  //   0x00, 0x00, 0x00, 0x00, 0x00, 0x00, 0x00, 0x00, 0x00, 0x00, 0x00, 0x00, 0x00, 0x00, 0x00, 0x00,
  //   0x00, 0x00, 0x00, 0x00, 0x00, 0x00, 0x00, 0x00, 0x00, 0x00, 0x00, 0x00, 0x00, 0x00, 0x00, 0x00,
  //   0x00, 0x00, 0x00, 0x00, 0x00, 0x00, 0x00, 0x00, 0x00, 0x00, 0x00, 0x00, 0x00, 0x00, 0x00, 0x00,
  //   0x00, 0x00, 0x00, 0x00, 0x00, 0x00, 0x00, 0x00, 0x00, 0x00, 0x00, 0x00, 0x00, 0x00, 0x00, 0x00,
  //   0x00, 0x00, 0x00, 0x00, 0x00, 0x00, 0x00, 0x00, 0x00, 0x00, 0x00, 0x00, 0x00, 0x00, 0x00, 0x00,
  //   0x00, 0x00, 0x00, 0x00, 0x00, 0x00, 0x00, 0x00, 0x00, 0x00, 0x00, 0x00, 0x00, 0x00, 0x00, 0x00,
  //   0x00, 0x00, 0x00, 0x00, 0x00, 0x00, 0x00, 0x00, 0x00, 0x00, 0x00, 0x00, 0x00, 0x00, 0x00, 0x00,
  //   0x00, 0x00, 0x00, 0x00, 0x00, 0x00, 0x00, 0x00, 0x00, 0x00, 0x00, 0x00, 0x00, 0x00, 0x00, 0x00,
  //   0x00, 0x00, 0x00, 0x00, 0x00, 0x00, 0x00, 0x00, 0x00, 0x00, 0x00, 0x00, 0x00, 0x00, 0x00, 0x00,
  //   0x00, 0x00, 0x00, 0x00, 0x00, 0x00, 0x00, 0x00, 0x00, 0x00, 0x00, 0x00, 0x00, 0x00, 0x00, 0x00,
  //   0x00, 0x00, 0x00, 0x00, 0x00, 0x00, 0x00, 0x00, 0x00, 0x00, 0x00, 0x00, 0x00, 0x00, 0x00, 0x00,
  //   0x00, 0x00, 0x00, 0x00, 0x00, 0x00, 0x00, 0x00, 0x00, 0x00, 0x00, 0x00, 0x00, 0x00, 0x00, 0x00,
  //   0x00, 0x00, 0x00, 0x00, 0x00, 0x00, 0x00, 0x00, 0x00, 0x00, 0x00, 0x00, 0x00, 0x00, 0x00, 0x00,
  //   0x00, 0x00, 0x00, 0x00, 0x00, 0x00, 0x00, 0x00, 0x00, 0x00, 0x00, 0x00, 0x00, 0x00, 0x00, 0x00,
  //   0x00, 0x00, 0x00, 0x00, 0x00, 0x00, 0x00, 0x00, 0x00, 0x00, 0x00, 0x00, 0x00, 0x00, 0x00, 0x00,
  //   0x00, 0x00, 0x00, 0x00, 0x00, 0x00, 0x00, 0x00, 0x00, 0x00, 0x00, 0x00, 0x00, 0x00, 0x00, 0x00,
  //   0x00, 0x00, 0x00, 0x00, 0x00, 0x00, 0x00, 0x00, 0x00, 0x00, 0x00, 0x00, 0x00, 0x00, 0x00, 0x00,
  //   0x00, 0x00, 0x00, 0x00, 0x00, 0x03, 0xff, 0xff, 0xff, 0xf0, 0x00, 0x00, 0x00, 0x00, 0x00, 0x00,
  //   0x00, 0x00, 0x00, 0x00, 0x00, 0x03, 0xff, 0xff, 0xff, 0xf0, 0x00, 0x00, 0x00, 0x00, 0x00, 0x00,
  //   0x00, 0x00, 0x00, 0x00, 0x00, 0x03, 0xff, 0xff, 0xff, 0xf0, 0x00, 0x00, 0x00, 0x00, 0x00, 0x00,
  //   0x00, 0x00, 0x00, 0x00, 0x00, 0x03, 0xff, 0xff, 0xff, 0xf0, 0x00, 0x00, 0x00, 0x00, 0x00, 0x00,
  //   0x00, 0x00, 0x00, 0x00, 0x00, 0x03, 0xff, 0xff, 0xff, 0xf0, 0x00, 0x00, 0x00, 0x00, 0x00, 0x00,
  //   0x00, 0x00, 0x00, 0x00, 0x00, 0x03, 0xff, 0xff, 0xff, 0xf0, 0x00, 0x00, 0x00, 0x00, 0x00, 0x00,
  //   0x00, 0x00, 0x00, 0x00, 0x00, 0x03, 0xff, 0xff, 0xff, 0xf0, 0x00, 0x00, 0x00, 0x00, 0x00, 0x00,
  //   0x00, 0x00, 0x00, 0x00, 0x00, 0x03, 0xff, 0xff, 0xff, 0xf0, 0x00, 0x00, 0x00, 0x00, 0x00, 0x00,
  //   0x00, 0x00, 0x00, 0x00, 0x00, 0x03, 0xff, 0xff, 0xff, 0xf0, 0x00, 0x00, 0x00, 0x00, 0x00, 0x00,
  //   0x00, 0x00, 0x00, 0x00, 0x00, 0x03, 0xff, 0xff, 0xff, 0xf0, 0x00, 0x00, 0x00, 0x00, 0x00, 0x00
  // };
  // curFace++;
  roboEyes.update();  // update eyes drawings
  // switch (curFace) {
  //   case 1:
  //     oled.clearDisplay();
  //     oled.drawBitmap(0, 0, rigth, 128, 64, WHITE);
  //     oled.display();
  //     break;
  //   case 2:
  //     oled.clearDisplay();
  //     oled.drawBitmap(0, 0, midle, 128, 64, WHITE);
  //     oled.display();
  //     break;
  //   case 3:
  //     oled.clearDisplay();
  //     oled.drawBitmap(0, 0, left, 128, 64, WHITE);
  //     oled.display();
  //     break;
  //   case 4:
  //     oled.clearDisplay();
  //     oled.drawBitmap(0, 0, midle, 128, 64, WHITE);
  //     oled.display();
  //     curFace = 0;
  //     break;
  // }  // Animacia

}  // face

void setting(int ktore) {
  switch (ktore) {
    case 0:
      myTime = millis();
      // if (myTime - myTimeLast >= 1250) {
      face();
      //   myTimeLast = myTime;
      // }
      {
        long pos_face = encoder.getCount() / 2;
        if (pos_face > old_pos_face) {   //otacanie doprava
          if (!button1.getStateRaw()) {  //zatlacene tlacidlo
            bleKeyboard.write(KEY_MEDIA_VOLUME_UP);
            old_pos_face = pos_face;    //aktualna pozicia
            myTimeLast_media = myTime;  //cas vykonania akcie
            return;
          }
          if ((myTime - myTimeLast_media) >= 60) {
            bleKeyboard.write(KEY_MEDIA_NEXT_TRACK);
            myTimeLast_media = myTime;
          }
          old_pos_face = pos_face;
        }
        if (pos_face < old_pos_face) {  //otacanie dolava
          if (!button1.getStateRaw()) {
            bleKeyboard.write(KEY_MEDIA_VOLUME_DOWN);
            old_pos_face = pos_face;
            myTimeLast_media = myTime;
            return;
          }
          if ((myTime - myTimeLast_media) >= 60) {
            bleKeyboard.write(KEY_MEDIA_PREVIOUS_TRACK);
            myTimeLast_media = myTime;
          }
          old_pos_face = pos_face;
        }
      }
      break;
    case 1:
      if (connected) {
        float voltageTemp = myELM327.batteryVoltage();
        if (myELM327.nb_rx_state == ELM_SUCCESS) {
          voltage = voltageTemp;
        }

      }  // ELM327

      oled.clearDisplay();  // refresh display for next step
      //display.drawBitmap(0, 0, VUMeter, 128, 64, WHITE);
      oled.drawBitmap(8, 0, batteryVoltMeter, 118, 50, WHITE);
      oled.drawLine((103 - (15 - voltage) * 13), (85 - (cos(voltage / 57.296) * 64)), 64, 64, WHITE);  // draws needle
      oled.setCursor(50, 55);
      oled.print(voltage);
      oled.display();
      break;
    case 2:
      oled.clearDisplay();
      //needle_angle_deg = map(kph, 0, 140, 45, 270 + 45);  // calculate the angle in degrees based on the speed value, between 45-315

      needle_start_x = needle_radius_big * -sin(radians(needle_angle_deg)) + needle_center_x;  // calculate needle start x position
      needle_start_y = needle_radius_big * cos(radians(needle_angle_deg)) + needle_center_y;   // calculate needle start y position

      needle_end_x = needle_radius_small * -sin(radians(needle_angle_deg + 180)) + needle_center_x;  // calculate needle end x position
      needle_end_y = needle_radius_small * cos(radians(needle_angle_deg + 180)) + needle_center_y;   // calculate needle end y position
      // calculate offset for the second line for the needle, based on the needle slope
      if ((needle_angle_deg > 45 && needle_angle_deg < 135) || (needle_angle_deg > 225 && needle_angle_deg < 315)) {  // needle is more horizontal, offset the second line by y
        needle_offset_x = 0;
        needle_offset_y = 1;
      } else {  // needle is more vertical, offset the second line by x
        needle_offset_x = 1;
        needle_offset_y = 0;
        oled.drawBitmap(28, 0, bitmap_gauge_bg, 72, 64, WHITE);                                                                                                              // draw gauge background image
        oled.drawLine(needle_start_x + 28, needle_start_y, needle_end_x + 28, needle_end_y, WHITE);                                                                          // draw first line for the needle
        oled.drawLine(needle_start_x + needle_offset_x + 28, needle_start_y + needle_offset_y, needle_end_x + needle_offset_x + 28, needle_end_y + needle_offset_y, WHITE);  // draw second line for the needle
        oled.drawBitmap(32 + 28, 33, bitmap_center_fill, 8, 8, WHITE);                                                                                                       // draw needle center cover
        oled.drawBitmap(32 + 28, 33, bitmap_center_outline, 8, 8, WHITE);                                                                                                    // draw needle center piece
        oled.display();
      }
      break;
    case 3:
      oled.clearDisplay();
      oled.drawBitmap(40, 10, button, 32, 32, WHITE);
      oled.setCursor(15, 45);
      if (connected) {
        oled.print("Connected to ELM327");
      }
      oled.print("Press to Connect");
      oled.display();

      if (pinButton1.isSingleClick()) {
        if (!connected) {
          oled.clearDisplay();
          oled.drawBitmap(40, 10, Bluetooth32, 32, 32, WHITE);
          oled.setCursor(15, 45);
          oled.print("Connecting...");
          oled.display();
          if (ELM_PORT.connect(address)) {  //"OBDII" replaced by "address"
            myELM327.begin(ELM_PORT);
            connected = true;
          }
        }
      }
      break;
    case 4:
      if (connected) {
        float fuelPressureTemp = myELM327.fuelPressure();
        if (myELM327.nb_rx_state == ELM_SUCCESS) {
          fuelPressure = fuelPressureTemp;
        }

        float fuelLevelTemp = myELM327.fuelLevel();
        if (myELM327.nb_rx_state == ELM_SUCCESS) {
          fuelLevel = fuelLevelTemp;
        }

        float intakeAirTempTemp = myELM327.intakeAirTemp();
        if (myELM327.nb_rx_state == ELM_SUCCESS) {
          intakeAirTemp = intakeAirTempTemp;
        }

      }  // ELM327

      oled.clearDisplay();
      oled.setCursor(0, 0);
      oled.print(intakeAirTemp);
      oled.setCursor(40, 0);
      oled.println(fuelLevel);
      oled.drawBitmap(45, 4, gas_can, 36, 56, WHITE);
      oled.fillRect(47, 18, 31, map(fuelLevel, 0, 100, 39, 0), BLACK);
      oled.display();
      break;
    case 5:
      relayMenu();
      break;
    case 6:
      interiorMenu();
      break;
    case 7:

      break;
  }
}  //setting